#include <Adafruit_NeoPixel.h>

#define LED_PIN 1
#define LED_COUNT 22
#define DELAY 15
#define OFFSET 64 // Used to distribute LED positions in gamma array

#define MODE_BUTTON 2

#define SHUTDOWN 0
#define STEADY 1
#define FADE 2

#define Y_R 255
#define Y_G 200
#define Y_B 200

#define STEADY_BRIGHTNESS_PERC 0.5

int mode = FADE;

Adafruit_NeoPixel strip(LED_COUNT, LED_PIN, NEO_GRB + NEO_KHZ800);

const uint8_t PROGMEM gamma8[] = {
    0,  0,  0,  0,  0,  0,  0,  0,  0,  0,  0,  0,  0,  0,  0,  0,
    0,  0,  0,  0,  0,  0,  0,  0,  0,  0,  0,  0,  1,  1,  1,  1,
    1,  1,  1,  1,  1,  1,  1,  1,  1,  2,  2,  2,  2,  2,  2,  2,
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  215,218,220,223,225,228,231,233,236,239,241,244,247,249,252,255
};

const uint16_t PROGMEM gamma16[] = {
    0,  0,  0,  0,  0,  0,  0,  0,  0,  0,  0,  0,  0,  0,  0,  0,
    0,  0,  0,  0,  0,  0,  0,  0,  0,  0,  0,  0,  1,  1,  1,  1,
    1,  1,  1,  1,  1,  1,  1,  1,  1,  2,  2,  2,  2,  2,  2,  2,
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    0,  0,  0,  0,  0,  0,  0,  0,  0,  0,  0,  0,  0,  0,  0,  0};


void setup() {
  strip.begin();
  strip.clear();
  strip.show();
  pinMode(MODE_BUTTON, INPUT_PULLUP);
}

void loop() {
  if(mode == SHUTDOWN) {
    strip.clear();
    strip.show();
  } 
  else if(mode == STEADY) {
    steady();
  } else if(mode == FADE) {
    cross_fade();
  }
  check_mode_change();
  delay(10);
}

void check_mode_change() {
  if(digitalRead(MODE_BUTTON) == LOW) {
    wait_for_button_up();
    change_mode();
  }
}

void wait_for_button_up() {
  while (digitalRead(MODE_BUTTON) == LOW) {
    delay(10);
  }
}


void change_mode() {
  if(mode < 2) {
    mode++;
  } else {
    mode = 0;
  }
}

void steady() {
  for(int i=0; i < LED_COUNT; i++) {
    strip.setPixelColor(i, (int)Y_R*STEADY_BRIGHTNESS_PERC, (int)Y_G*STEADY_BRIGHTNESS_PERC, (int)Y_B*STEADY_BRIGHTNESS_PERC);
  }
  strip.show();
}

void cross_fade() {
  for(int i=0; i < 512; i++) {
    for(int j=0; j<LED_COUNT; j++) {
      uint8_t result = pgm_read_byte(&gamma16[(i+OFFSET*j)%512]);
      float intensity_pct = result / 255.0;
      strip.setPixelColor(j, (int)Y_R*intensity_pct, (int)Y_G*intensity_pct, (int)Y_B*intensity_pct);
      check_mode_change();
      if(mode != FADE) {
        return;
      }
    }
    strip.show();
    delay(DELAY);
  }
}